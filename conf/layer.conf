## conf/layer.conf
```bitbake
# We have a conf and classes directory, add to BBPATH
BBPATH .= ":${LAYERDIR}"

# We have recipes-* directories, add to BBFILES
BBFILES += "${LAYERDIR}/recipes-*/*/*.bb \
            ${LAYERDIR}/recipes-*/*/*.bbappend"

BBFILE_COLLECTIONS += "meta-dey-ml"
BBFILE_PATTERN_meta-dey-ml = "^${LAYERDIR}/"
BBFILE_PRIORITY_meta-dey-ml = "6"

LAYERDEPENDS_meta-dey-ml = "core"
LAYERSERIES_COMPAT_meta-dey-ml = "warrior zeus"
```
